## main/Kconfig.projbuild
```kconfig
menu "JellingStone configuration"

config MQTT_COMPRESSION
    bool "Enable zlib compression for MQTT messages"
    default N

endmenu
```

## sdkconfig.defaults
```kconfig
CONFIG_PARTITION_TABLE_SINGLE_APP_LARGE=y
CONFIG_BT_ENABLED=y
CONFIG_BTDM_CTRL_MODE_BLE_ONLY=y
```
